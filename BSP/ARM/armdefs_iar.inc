;
; armdefs.inc  (IAR version)                                Version 5.4.0
;
; ARM main definitions file for assembly files.
;
; Copyright (c) 2001-2025 Micro Digital Inc.
; All rights reserved. www.smxrtos.com
;
; This software, documentation, and accompanying materials are made available
; under the Apache License, Version 2.0. You may not use this file except in
; compliance with the License. http://www.apache.org/licenses/LICENSE-2.0
;
; SPDX-License-Identifier: Apache-2.0
;
; This Work is protected by patents listed in smx.h. A patent license is
; granted according to the License above. This entire comment block must be
; preserved in all copies of this file.
;
; Support services are offered by MDI. Inquire at support@smxrtos.com.
;
; Author: David Moore
;
;*****************************************************************************


;---- Master Includes -----------------------------------------------------

; Add includes here like armdefs.h if you write assembly application code.

